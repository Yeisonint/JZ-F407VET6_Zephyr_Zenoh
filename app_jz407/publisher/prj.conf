## CMakeLists.txt
```
cmake_minimum_required(VERSION 3.20.0)
find_package(Zephyr REQUIRED HINTS $ENV{ZEPHYR_BASE})
project(zenoh_pico_publisher)

include(ExternalProject)
include(CMakePrintHelpers)

zephyr_get_system_include_directories_for_lang_as_string(C ext_system_includes)
zephyr_get_include_directories_for_lang_as_string(C ext_includes)
zephyr_get_compile_definitions_for_lang_as_string(C ext_defs)
zephyr_get_compile_options_for_lang_as_String(C ext_opts)
set(ZENOHPICO_CFLAGS
        "${ZENOHPICO_CFLAGS} ${ext_defs} ${ext_system_includes} ${ext_includes} ${ext_opts}"
)

set(ZENOHPICO_SRC_DIR ${CMAKE_CURRENT_SOURCE_DIR}/../../modules/lib/zenoh-pico)
set(ZENOHPICO_BIN_DIR ${CMAKE_BINARY_DIR}/zenoh-pico)
set(ZENOHPICO_INC_DIR ${ZENOHPICO_BIN_DIR}/include)
set(ZENOHPICO_LIB ${ZENOHPICO_BIN_DIR}/lib/libzenohpico.a)

ExternalProject_Add(zenoh-pico-ext
    SOURCE_DIR ${ZENOHPICO_SRC_DIR}
    BINARY_DIR ${ZENOHPICO_BIN_DIR}
    CMAKE_ARGS
        -DWITH_ZEPHYR=ON
        -DBUILD_TOOLS=OFF
        -DBUILD_TESTING=OFF
        -DBUILD_EXAMPLES=OFF
        -DCMAKE_SYSTEM_NAME=Generic
        -DCMAKE_TRY_COMPILE_TARGET_TYPE=STATIC_LIBRARY
        -DCMAKE_C_FLAGS=${ZENOHPICO_CFLAGS}
        -DCMAKE_C_COMPILER=${CMAKE_C_COMPILER}
        -DCMAKE_INSTALL_PREFIX=${ZENOHPICO_BIN_DIR}
        -DZENOH_DEBUG=0
        -DZ_FEATURE_PUBLICATION=1
    DEPENDS zephyr_interface
    BUILD_BYPRODUCTS ${ZENOHPICO_LIB}
)
add_library(zenohpico_lib STATIC IMPORTED GLOBAL)
add_dependencies(zenohpico_lib zenoh-pico-ext)
set_target_properties(zenohpico_lib PROPERTIES IMPORTED_LOCATION ${ZENOHPICO_LIB})
add_definitions(-DZENOH_ZEPHYR)

target_include_directories(app PRIVATE ${ZENOHPICO_INC_DIR})

target_link_libraries(app PRIVATE zenohpico_lib)

target_sources(app PRIVATE src/main.c)
```

## prj.conf
```kconfig
# Kernel options
CONFIG_MAIN_STACK_SIZE=4096
CONFIG_HEAP_MEM_POOL_SIZE=16384
CONFIG_INIT_STACKS=y

# Generic library options
CONFIG_NEWLIB_LIBC=y
CONFIG_NEWLIB_LIBC_NANO=n
CONFIG_POSIX_API=y

# Generic networking options
CONFIG_SERIAL=y
CONFIG_NETWORKING=y

CONFIG_NET_L2_ETHERNET=y
# CONFIG_ETH_NATIVE_POSIX=y

CONFIG_NET_IPV4=y
CONFIG_NET_IPV6=y
CONFIG_NET_TCP=y
CONFIG_NET_ARP=y
CONFIG_NET_UDP=y
CONFIG_NET_DHCPV4=y
CONFIG_NET_DHCPV4_OPTION_CALLBACKS=y
CONFIG_NET_SHELL=y
CONFIG_NET_MGMT=y
CONFIG_NET_MGMT_EVENT=y
CONFIG_DNS_RESOLVER=y

# Sockets
CONFIG_NET_SOCKETS=y
# CONFIG_NET_SOCKETS_POSIX_NAMES=y
CONFIG_NET_SOCKETS_POLL_MAX=4

# Network driver config
CONFIG_TEST_RANDOM_GENERATOR=y
CONFIG_INIT_STACKS=y

# Network buffers
CONFIG_NET_PKT_RX_COUNT=16
CONFIG_NET_PKT_TX_COUNT=16
CONFIG_NET_BUF_RX_COUNT=80
CONFIG_NET_BUF_TX_COUNT=80
CONFIG_NET_CONTEXT_NET_PKT_POOL=y

# Network address config
CONFIG_NET_CONFIG_SETTINGS=y
CONFIG_NET_CONFIG_NEED_IPV4=n
CONFIG_NET_IPV4_IGMP=y
CONFIG_NET_CONFIG_NEED_IPV6=n
# CONFIG_NET_IPV6_MLD=n

# IP address options
CONFIG_NET_IF_UNICAST_IPV6_ADDR_COUNT=3
CONFIG_NET_IF_MCAST_IPV6_ADDR_COUNT=4
CONFIG_NET_MAX_CONTEXTS=10

# Logging
# CONFIG_NET_LOG=y
CONFIG_LOG=y
# CONFIG_LOG_DEFAULT_LEVEL=4
# CONFIG_NET_STATISTICS=y
# CONFIG_PRINTK=y

# CONFIG_ASSERT=y
# CONFIG_THREAD_NAME=y
# CONFIG_THREAD_STACK_INFO=y
# CONFIG_THREAD_MONITOR=y
# CONFIG_STACK_SENTINEL=y
# CONFIG_EXCEPTION_DEBUG=y
# CONFIG_FAULT_DUMP=2

# Watchdog
# CONFIG_WATCHDOG=y
# CONFIG_IWDG_STM32=y
# CONFIG_WDT_DISABLE_AT_BOOT=n
```

## src/main.c
```c
#include <stdio.h>
#include <string.h>
#include <zenoh-pico.h>
#include <unistd.h>

int publish_json(z_owned_session_t *session, z_owned_publisher_t *pub, const char *json)
{
  z_owned_bytes_t payload;
  z_bytes_copy_from_str(&payload, json);
  return z_publisher_put(z_loan(*pub), z_move(payload), NULL);
}

int main(void)
{
  while (true)
  {
    sleep(2);
    z_owned_config_t config;
    z_config_default(&config);
    zp_config_insert(z_loan_mut(config), Z_CONFIG_MODE_KEY, "client");
    zp_config_insert(z_loan_mut(config), Z_CONFIG_CONNECT_KEY, "tcp/192.168.12.103:7447");
  
    z_owned_session_t s;
    if (z_open(&s, z_move(config), NULL) < 0)
    {
      printk("Unable to open session!\n");
      continue;
    }
  
    zp_start_read_task(z_loan_mut(s), NULL);
    zp_start_lease_task(z_loan_mut(s), NULL);
  
    z_view_keyexpr_t ke_str, ke_imu, ke_bat;
    z_view_keyexpr_from_str_unchecked(&ke_str, "rt/status/string");
    z_view_keyexpr_from_str_unchecked(&ke_imu, "rt/sensor/imu");
    z_view_keyexpr_from_str_unchecked(&ke_bat, "rt/power/battery");
  
    z_owned_publisher_t pub_str, pub_imu, pub_bat;

    if (z_declare_publisher(z_loan(s), &pub_str, z_loan(ke_str), NULL) < 0) {
      printk("Unable to declare publisher for string topic!\n");
      continue;
    }

    if (z_declare_publisher(z_loan(s), &pub_imu, z_loan(ke_imu), NULL) < 0) {
      printk("Unable to declare publisher for imu tompic!\n");
      continue;
    }

    if (z_declare_publisher(z_loan(s), &pub_bat, z_loan(ke_bat), NULL) < 0) {
      printk("Unable to declare publisher for battery topic!\n");
      continue;
    }
  
    int counter = 0;
    printk("Ok!\n");
    while (1)
    {
      // 1. Mensaje tipo String
      char msg_buf[64];
      snprintf(msg_buf, sizeof(msg_buf), "{\"data\": \"Hi everyone! [%d]\"}", counter);
      if (publish_json(&s, &pub_str, msg_buf) < 0) {
        printk("Unable to publish message!\n");
        continue;
      }
  
      // 2. IMU JSON payload
      const char *imu_json =
          "{"
          "\"orientation\": {\"x\": 0.1, \"y\": 0.2, \"z\": 0.3, \"w\": 1.0},"
          "\"angular_velocity\": {\"x\": 0.01, \"y\": 0.02, \"z\": 0.03},"
          "\"linear_acceleration\": {\"x\": 9.8, \"y\": 0.0, \"z\": 0.0}"
          "}";
  
      if (publish_json(&s, &pub_imu, imu_json) < 0) {
        printk("Unable to publish message!\n");
        continue;
      }
      // 3. BatteryState JSON payload
      const char *bat_json =
          "{"
          "\"voltage\": 11.1,"
          "\"current\": 1.2,"
          "\"percentage\": 0.75"
          "}";
  
      if (publish_json(&s, &pub_bat, bat_json) < 0) {
        printk("Unable to publish message!\n");
        continue;
      }
  
      counter++;
      sleep(1);
    }
  }
  return 0;
}
```
