## app_jz407/boards/arm/JZ_F407VET6/JZ_F407VET6_defconfig
```kconfig
# Networking STM32 HAL Configuration
CONFIG_NET_L2_ETHERNET=y
CONFIG_ETH_DRIVER=y
CONFIG_ETH_STM32_HAL=y
CONFIG_ETH_STM32_HAL_RX_THREAD_STACK_SIZE=2048
CONFIG_ETH_STM32_HAL_PHY_ADDRESS=1
CONFIG_ENTROPY_GENERATOR=y

# Enable Clocks
CONFIG_CLOCK_CONTROL=y

# Enable pin controller
CONFIG_PINCTRL=y

CONFIG_GPIO=y
CONFIG_GPIO_STM32=y

# Enable UART
CONFIG_SERIAL=y

# Enable CAN
CONFIG_CAN=y

# Console
CONFIG_CONSOLE=y
CONFIG_UART_CONSOLE=y
CONFIG_GPIO_SHELL=y
CONFIG_CAN_SHELL=y
CONFIG_THREAD_MONITOR=y
```

## app_jz407/boards/arm/JZ_F407VET6/Kconfig.board
```kconfig
config BOARD_JZ_F407VET6
	bool "JZ F407VET6 custom board"
	depends on SOC_STM32F407XE
	
```

## app_jz407/west.yml
```yaml
manifest:

  self:
    path: .

  remotes:
    - name: zephyrproject-rtos
      url-base: https://github.com/zephyrproject-rtos

  projects:
    - name: zephyr
      remote: zephyrproject-rtos
      revision: v3.7.1
      path: zephyr
      import:
        name-allowlist:
          - cmsis
          - hal_stm32
          - hal_nordic
          - mbedtls
  
    - name: zenoh-pico
      url: https://github.com/eclipse-zenoh/zenoh-pico
      path: modules/lib/zenoh-pico
      revision: 1.3.2
```
